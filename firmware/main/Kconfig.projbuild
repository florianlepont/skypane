## firmware/main/Kconfig.projbuild
```kconfig
menu "FlightPortrait"

    config FP_API_BASE
        string "Device API base URL (compiled-in default)"
        default "https://api.flightportrait.com"
        help
            The ONE compiled-in endpoint: the production domain. At
            runtime a hand-set versioned NVS target (target_v1,
            PROTOCOL.md §5 BYOS) takes precedence; factory reset always
            returns the frame to this default. For bench work, enter a
            dev/BYOS target through BLE provisioning instead of changing
            this value.

    config FP_DEV_PROVISION_SECRET
        string "DEV ONLY: provision secret for POST /device/v1/setup"
        default ""
        help
            Bench-only seed copied once into the protected factory namespace.
            Production images MUST leave this blank; each unit is injected
            with its own high-entropy setup credential by the factory jig.

    config FP_HW_REV
        string "Hardware revision sent during setup"
        default "proto-e1004"

    menu "Panel pins (defaults: Seeed reTerminal E1004)"
        config FP_PIN_EPD_SCK
            int "EPD SPI SCK"
            default 7
        config FP_PIN_EPD_MOSI
            int "EPD SPI MOSI"
            default 9
        config FP_PIN_EPD_CS_M
            int "EPD CS master (left half)"
            default 10
        config FP_PIN_EPD_CS_S
            int "EPD CS slave (right half)"
            default 2
        config FP_PIN_EPD_DC
            int "EPD DC"
            default 11
        config FP_PIN_EPD_RST
            int "EPD RST"
            default 38
        config FP_PIN_EPD_BUSY
            int "EPD BUSY (low = busy)"
            default 13
        config FP_PIN_EPD_EN
            int "EPD power enable"
            default 12
    endmenu

    menu "Battery sense (EE02 driver board, Phase 5 / DEVICE-04)"
        config FP_PIN_BATTERY_ADC
            int "Battery voltage-sense ADC GPIO"
            range 1 10
            default 1
            help
              (a) The sense divider is a feature of the EE02 driver board,
              not of the bare XIAO module - the module's own documentation
              describes no such circuit, which is why researching the
              module alone finds nothing and wrongly suggests external
              components are needed; the circuit already exists and
              nothing is added to the hardware.
              (b) The divider halves the pack voltage, which is what
              keeps a full-charge 4.2 V cell inside the ADC's safe input
              range - the raw pack must never be routed to a GPIO
              directly.
              (c) The range is restricted to 1..10 because only ADC unit
              1 may be used - ADC unit 2 shares hardware with the Wi-Fi
              driver on the ESP32-S3 and returns unreliable readings
              whenever the radio is up, which on this device is exactly
              when telemetry is sent.
        config FP_PIN_BATTERY_ADC_EN
            int "Battery sense divider enable GPIO"
            range 0 48
            default 6
            help
              The board gates its own divider: this line has to be
              driven high before sampling, or the sense pin floats and
              the reading is meaningless. The firmware drives it low
              again immediately after the sample so the divider does not
              sit conducting across the pack through deep sleep on a
              device whose entire architecture (DEVICE-05) exists to
              minimise draw.
    endmenu

    menu "Bring-up LED (built-in User LED, bring-up/reflash aid only)"
        config FP_PIN_LED
            int "Built-in User LED GPIO"
            range 0 48
            default 21
            help
              (a) This is the XIAO ESP32-S3 module's built-in "User LED",
              distinct from the module's separate charge-status LED - it
              is driven by firmware, not hardware charge logic.
              (b) The value is sourced from web aggregation of Seeed
              community and board-reference material, and is explicitly
              NOT from an official schematic - unlike the panel pins,
              which came from a vendor header. See
              .planning/seeds/bring-up-debug-led-remote-toggle.md for the
              full provenance trail and the flash-and-observe check that
              promotes this from a claim to measured hardware fact.
              (c) This pin must never collide with a panel, key or
              battery-sense GPIO: driving a panel line mid-refresh
              corrupts the image rather than failing cleanly, which is a
              far worse failure than a debug LED simply not lighting.
        config FP_LED_ACTIVE_LOW
            bool "Built-in User LED is active-low"
            default y
            help
              Configurable rather than hardcoded because getting this
              wrong is the one outcome that actually costs battery: if
              the real polarity turns out inverted, the LED would be dark
              during the active wake window and lit through deep sleep -
              precisely the failure this design exists to prevent. Making
              this a Kconfig bool means the correction is a reflash, not
              a code change.
    endmenu

    menu "Panel"
        config FP_MIN_REFRESH_SPACING_S
            int "Minimum seconds between panel refreshes"
            range 30 86400
            default 60
            help
              The firmware defends the glass regardless of what the server
              asks for. Know the panel's own numbers before lowering this:
              the maker suggests updating ONCE A DAY, and their published
              reliability testing ran at 150 s intervals. Below 150 s is off
              the tested envelope — reasonable for a demo table under
              supervision, a deliberate choice for a frame that hangs on a
              customer's wall for years.
        config FP_MAX_GUARD_WAIT_S
            int "Longest the frame stays awake waiting out the guard"
            range 0 300
            default 90
            help
              An image is already in PSRAM by the time the guard is checked,
              and PSRAM does not survive deep sleep — sleeping the guard out
              would cost a second 960 KB download for the same picture. So
              the frame waits with the radio off and then blits. Past this
              ceiling it gives up and lets the next wake carry it.
    endmenu

    # Retained without a consumer. No button handler is compiled in this
    # project during Phase 1 - view switching is Phase 4's DEVICE-01. These
    # pin values are measured hardware fact from a real EE02 key-sweep (see
    # sdkconfig.ee02.defaults' "VERIFIED on hardware 2026-07-26" comment,
    # which overrides the E1004 defaults below with the EE02's own KEY0/1/2
    # GPIOs). Dropping this block now would mean re-deriving that same
    # key-sweep measurement when Phase 4 needs it.
    menu "E1004 controls (active low)"
        config FP_PIN_KEY0
            int "PCB KEY0 / right-arrow: admin hold"
            range 0 48
            default 3
        config FP_PIN_KEY1
            int "PCB KEY1 / left-arrow: show a new pairing QR"
            range 0 48
            default 4
        config FP_PIN_KEY2
            int "PCB KEY2 / circular-arrow: poll now"
            range 0 48
            default 5
        config FP_REPROVISION_HOLD_MS
            int "Admin Wi-Fi re-provision hold (milliseconds)"
            range 500 9000
            default 2000
        config FP_FACTORY_RESET_HOLD_MS
            int "Admin factory reset hold (milliseconds)"
            range 5000 30000
            default 10000
    endmenu

endmenu
```
